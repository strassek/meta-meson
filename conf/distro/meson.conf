## conf/distro/meson.conf
```bitbake
require conf/distro/poky.conf

DISTRO = "meson"
DISTRO_NAME = "Meson"
DISTRO_VERSION = "snapshot-${DATE}"

MAINTAINER = "Yocto Project <yocto@yoctoproject.org>"

DISTRO_FEATURES = " \
  ${DISTRO_FEATURES_LIBC} \
  x11 \
"

POKYQEMUDEPS = ""
```

## conf/machine/include/omap3.inc
```bitbake
SOC_FAMILY = "omap3"
require conf/machine/include/soc-family.inc

require conf/machine/include/tune-cortexa8.inc

TOOLCHAIN_PATH ?= "${STAGING_DIR_NATIVE}${prefix_native}/bin/${TUNE_PKGARCH}${HOST_VENDOR}-${HOST_OS}"
TOOLCHAIN_SYSPATH ?= "${TOOLCHAIN_PATH}/${TARGET_SYS}" 

# Increase this everytime you change something in the kernel
MACHINE_KERNEL_PR = "r1"

KERNEL_IMAGETYPE = "uImage"

UBOOT_ENTRYPOINT = "0x80008000"
UBOOT_LOADADDRESS = "0x80008000"

EXTRA_IMAGEDEPENDS += "u-boot-sakoman"
```

## conf/machine/omap3.conf
```bitbake
#@TYPE: Machine
#@NAME: OMAP3
#@DESCRIPTION: Multi-machine configuration for beagleboard and overo

require conf/machine/include/omap3-sakoman.inc

EXTRA_IMAGEDEPENDS += "u-boot-sakoman"

# there is no generic omap3 u-boot, so just build the overo one
PREFERRED_PROVIDER_virtual/bootloader = "u-boot-sakoman"
UBOOT_MACHINE = "omap3_overo_config"

PREFERRED_PROVIDER_virtual/kernel = "linux-sakoman"

PREFERRED_PROVIDER_virtual/xserver = "xserver-xorg"
XSERVER = "xserver-xorg \
           xf86-input-evdev \
           xf86-input-mouse \
           xf86-video-omapfb \
           xf86-input-keyboard"

IMAGE_FSTYPES += "tar.bz2"

SERIAL_CONSOLE = "115200 ttyO2"

MACHINE_EXTRA_RRECOMMENDS = " kernel-modules"
MACHINE_FEATURES = "kernel26 alsa ext2 vfat keyboard screen serial touchscreen usbgadget usbhost uboot"
```

## conf/machine/overo.conf
```bitbake
#@TYPE: Machine
#@NAME: OVERO
#@DESCRIPTION: Machine configuration for overo
TARGET_ARCH = "arm"

require conf/machine/include/omap3.inc

# there is no generic omap3 u-boot, so just build the overo one
PREFERRED_PROVIDER_virtual/bootloader = "u-boot-sakoman"
UBOOT_MACHINE = "omap3_overo_config"

PREFERRED_PROVIDER_virtual/kernel = "linux-sakoman"

PREFERRED_PROVIDER_virtual/xserver = "xserver-xorg"
XSERVER = "xserver-xorg \
           xf86-input-evdev \
           xf86-input-mouse \
           xf86-video-omapfb \
           xf86-input-keyboard"

IMAGE_FSTYPES += "tar.bz2"

SERIAL_CONSOLE = "115200 ttyO2"

MACHINE_EXTRA_RRECOMMENDS = " kernel-modules"
MACHINE_FEATURES = "kernel26 alsa ext2 vfat keyboard screen serial touchscreen usbgadget usbhost uboot"
```
